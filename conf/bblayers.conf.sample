## conf/bblayers.conf.sample
```bitbake
# POKY_BBLAYERS_CONF_VERSION is increased each time build/conf/bblayers.conf
# changes incompatibly
POKY_BBLAYERS_CONF_VERSION = "2"

BBPATH = "${TOPDIR}"
BBFILES ?= ""

YOCTO_ROOT = "${@os.path.abspath(os.path.join("${TOPDIR}", os.pardir))}"

BBLAYERS ?= " \
  ${YOCTO_ROOT}/yocto-layers/poky/meta \
  ${YOCTO_ROOT}/yocto-layers/poky/meta-poky \
  ${YOCTO_ROOT}/yocto-layers/meta-openembedded/meta-oe \
  ${YOCTO_ROOT}/yocto-layers/meta-openembedded/meta-networking \
  ${YOCTO_ROOT}/yocto-layers/meta-openembedded/meta-python \
  ${YOCTO_ROOT}/yocto-layers/meta-freescale \
  ${YOCTO_ROOT}/yocto-layers/meta-somlabs-bsp \
  "
```

## conf/layer.conf
```bitbake
# We have a conf and classes directory, add to BBPATH
BBPATH .= ":${LAYERDIR}"

# We have recipes-* directories, add to BBFILES
BBFILES += "${LAYERDIR}/recipes-*/*/*.bb \
    ${LAYERDIR}/recipes-*/*/*.bbappend"

BBFILE_COLLECTIONS += "somlabs-bsp-layer"
BBFILE_PATTERN_somlabs-bsp-layer = "^${LAYERDIR}/"
BBFILE_PRIORITY_somlabs-bsp-layer = "10"

LAYERSERIES_COMPAT_somlabs-bsp-layer =  "warrior zeus dunfell"
LAYERDEPENDS_somlabs-bsp-layer = "core freescale-layer"

BBFILES_DYNAMIC += " \
    qt5-layer:${LAYERDIR}/dynamic-layers/qt5-layer/*/*/*.bb \
    qt5-layer:${LAYERDIR}/dynamic-layers/qt5-layer/*/*/*.bbappend \
"
```

## conf/machine/include/visionsom6ull-nand-config.inc
```bitbake
# Image types add UBIimage type for NAND boards
IMAGE_FSTYPES += "ubi"

UBI_VOLNAME = "rootfs"

# UBI settings for 256MB NAND
#MKUBIFS_ARGS = "-F -m 2048 -e 126976 -c 5600"
#UBINIZE_ARGS = "-m 2048 -p 128KiB -s 512 -O 2048"


# UBI settings for 512MB NAND
MKUBIFS_ARGS = "-F -m 4096 -e 253952 -c 2650"
UBINIZE_ARGS = "-m 4096 -p 256KiB -s 4096 -O 4096"
```

## conf/machine/include/visionsom6ull-wifi-bluetooth.inc
```bitbake
# Murata Wifi + Bluetooth 1DX module support

# add machine features
MACHINE_FEATURES += "wifi bluetooth"

#Firmware for Murata Wi-Fi module + software utils
IMAGE_INSTALL_append = "\
    linux-firmware-bcm43430 \
    linux-firmware-bcm43430a1-hcd \
    packagegroup-base-wifi \
    packagegroup-base-bluetooth \
"
```

## conf/machine/include/visionsom6ull.inc
```bitbake
# SoMLabs VisionSOM-6ULL common board definition file

# compatibility with mx6 machines
MACHINEOVERRIDES =. "mx6:mx6ul:mx6ull:"
IMX_DEFAULT_BSP = "nxp"

include conf/machine/include/imx-base.inc
include conf/machine/include/tune-cortexa7.inc

# u-boot and kernel providers
PREFERRED_PROVIDER_u-boot = "u-boot-somlabs"
PREFERRED_PROVIDER_u-boot-fw-utils = "u-boot-somlabs-fw-utils"

PREFERRED_PROVIDER_virtual/bootloader = "u-boot-somlabs"
PREFERRED_PROVIDER_virtual/kernel = "linux-imx"

# Use i.MX Gstreamer Version
PREFERRED_VERSION_gstreamer1.0 = "1.16.imx"
PREFERRED_VERSION_gstreamer1.0-plugins-base = "1.16.imx"
PREFERRED_VERSION_gstreamer1.0-plugins-good = "1.16.imx"
PREFERRED_VERSION_gstreamer1.0-plugins-bad = "1.16.imx"

SERIAL_CONSOLE = "115200 ttymxc0"

# u-boot configurations
UBOOT_CONFIG[sd]   = "somlabs_visionsom_6ull_fastboot_mmc_defconfig"
UBOOT_CONFIG[emmc] = "somlabs_visionsom_6ull_fastboot_mmc_defconfig"
UBOOT_CONFIG[nand] = "somlabs_visionsom_6ull_fastboot_nand_defconfig"

# always depend of u-boot
EXTRA_IMAGEDEPENDS += "u-boot-somlabs"

# add u-boot utils + kernel to image
IMAGE_INSTALL_append = " \
    kernel-image \
    kernel-devicetree \
    kernel-modules \
    u-boot-splash \
    u-boot-somlabs-fw-utils \
"  

IMAGE_FSTYPES = "wic.gz"

# single partition image
WKS_FILE = "imx-uboot.wks"
```

## conf/machine/visioncb-std-visionsom-6ull-emmc-wifi.conf
```bitbake
#@TYPE: Machine
#@NAME: SLS16Y2_792C_512R_04GE_1WB board
#@DESCRIPTION: Machine configuration for SoMLabs SLS16Y2 (VisionSOM-6ULL) with 512MB RAM, EMMC and WiFi/Bluetooth board

include visionsom6ull.inc
include visionsom6ull-wifi-bluetooth.inc

# u-boot configuration for this board
UBOOT_CONFIG ??= "emmc"

# Device tree
KERNEL_DEVICETREE = "visioncb-std-visionsom-6ull-emmc-wifi.dtb"
```

## conf/machine/visioncb-std-visionsom-6ull-emmc.conf
```bitbake
#@TYPE: Machine
#@NAME: SLS16Y2_792C_512R_04GE_0SF board
#@DESCRIPTION: Machine configuration for SoMLabs SLS16Y2 (VisionSOM-6ULL) with 512MB RAM, EMMC

include visionsom6ull.inc

# u-boot configuration for this board
UBOOT_CONFIG ??= "emmc"

# Device tree
KERNEL_DEVICETREE = "visioncb-std-visionsom-6ull-emmc.dtb"
```

## conf/machine/visioncb-std-visionsom-6ull-nand256-wifi.conf
```bitbake
#@TYPE: Machine
#@NAME: SLS16Y2_792C_512R_256N_1WB board
#@DESCRIPTION: Machine configuration for SoMLabs SLS16Y2 (VisionSOM-6ULL) with 512MB RAM, NAND and WiFi/Bluetooth

include visionsom6ull.inc
include visionsom6ull-wifi-bluetooth.inc

# u-boot configuration for this board
UBOOT_CONFIG ??= "nand"

# Device tree
KERNEL_DEVICETREE = "visioncb-std-visionsom-6ull-nand-wifi.dtb"

# Image types, add UBI to flash the board
IMAGE_FSTYPES += "ubi"

# UBI settings for 256MB NAND
UBI_VOLNAME = "rootfs"
MKUBIFS_ARGS = "-F -m 2048 -e 126976 -c 5600"
UBINIZE_ARGS = "-m 2048 -p 128KiB -s 512 -O 2048"
```

## conf/machine/visioncb-std-visionsom-6ull-nand512-wifi.conf
```bitbake
#@TYPE: Machine
#@NAME: SLS16Y2_792C_512R_512N_1WB board
#@DESCRIPTION: Machine configuration for SoMLabs SLS16Y2 (VisionSOM-6ULL) with 512MB RAM, NAND and WiFi/Bluetooth

include visionsom6ull.inc
include visionsom6ull-wifi-bluetooth.inc

# u-boot configuration for this board
UBOOT_CONFIG ??= "nand"

# Device tree
KERNEL_DEVICETREE = "visioncb-std-visionsom-6ull-nand-wifi.dtb"

# Image types, add UBI to flash the board
IMAGE_FSTYPES += "ubi"

# UBI settings for 512MB NAND
UBI_VOLNAME = "rootfs"
MKUBIFS_ARGS = "-F -m 4096 -e 253952 -c 2650"
UBINIZE_ARGS = "-m 4096 -p 256KiB -s 4096 -O 4096"
```

## conf/machine/visioncb-std-visionsom-6ull-nand512.conf
```bitbake
#@TYPE: Machine
#@NAME: SLS16Y2_792C_512R_512N_0SF board
#@DESCRIPTION: Machine configuration for SoMLabs SLS16Y2 (VisionSOM-6ULL) with 512MB RAM, NAND

include visionsom6ull.inc

# u-boot configuration for this board
UBOOT_CONFIG ??= "nand"

# Device tree
KERNEL_DEVICETREE = "visioncb-std-visionsom-6ull-nand.dtb"

# Single partition on SD card
WKS_FILE = "imx-uboot.wks"

# Image types, add UBI to flash the board
IMAGE_FSTYPES += "ubi"

# UBI settings for 512MB NAND
UBI_VOLNAME = "rootfs"
MKUBIFS_ARGS = "-F -m 4096 -e 253952 -c 2650"
UBINIZE_ARGS = "-m 4096 -p 256KiB -s 4096 -O 4096"
```

## conf/machine/visioncb-std-visionsom-6ull-sd-wifi.conf
```bitbake
#@TYPE: Machine
#@NAME: SLS16Y2_792C_512R_SD_1WB board
#@DESCRIPTION: Machine configuration for SoMLabs SLS16Y2 (VisionSOM-6ULL) with 512MB RAM, SD card and WiFi/Bluetooth

include visionsom6ull.inc
include visionsom6ull-wifi-bluetooth.inc

# u-boot configuration for this board
UBOOT_CONFIG ??= "sd"

# Device tree
KERNEL_DEVICETREE = "visioncb-std-visionsom-6ull-sd-wifi.dtb"
```

## conf/machine/visioncb-std-visionsom-6ull-sd.conf
```bitbake
#@TYPE: Machine
#@NAME: SLS16Y2_792C_512R_SD_0SF board
#@DESCRIPTION: Machine configuration for SoMLabs SLS16Y2 (VisionSOM-6ULL) with 512MB RAM, SD card

include visionsom6ull.inc

# u-boot configuration for this board
UBOOT_CONFIG ??= "sd"

# Device tree
KERNEL_DEVICETREE = "visioncb-std-visionsom-6ull-sd.dtb"

# Single partition on SD card
WKS_FILE = "imx-uboot.wks"
```

## conf/machine/visionsom6ull-cb-std.conf
```bitbake
#@TYPE: Machine
#@NAME: SLS16Y2_792C_512R_xx_0SF board
#@DESCRIPTION: Machine configuration for 
# SoMLabs SLS16Y2 (VisionSOM-6ULL) without WiFi/Bluetooth 
# on VisionCB-STD carrier board

require conf/machine/include/visionsom6ull.inc
require conf/machine/include/visionsom6ull-nand-config.inc

# u-boot configuration for this board
UBOOT_CONFIG ??= "sd"

# Device tree
KERNEL_DEVICETREE = " \
        visioncb-std-visionsom-6ull-wifi.dtb      \
        visioncb-std-visionsom-6ull-wifi-emmc.dtb \
        visioncb-std-visionsom-6ull-wifi-nand.dtb \
"
```

## conf/machine/visionsom6ull-wifi-cb-std.conf
```bitbake
#@TYPE: Machine
#@NAME: SLS16Y2_792C_512R_xx_1WB board
#@DESCRIPTION: Machine configuration for 
# SoMLabs SLS16Y2 (VisionSOM-6ULL) with WiFi/Bluetooth 
# on VisionCB-STD carrier board

require conf/machine/include/visionsom6ull.inc
require conf/machine/include/visionsom6ull-nand-config.inc
require conf/machine/include/visionsom6ull-wifi-bluetooth.inc

# u-boot configurations for this board
UBOOT_CONFIG ??= "sd emmc nand"

# Device tree
KERNEL_DEVICETREE = " \
        visioncb-std-visionsom-6ull-wifi.dtb      \
        visioncb-std-visionsom-6ull-wifi-emmc.dtb \
        visioncb-std-visionsom-6ull-wifi-nand.dtb \
"
```

## conf/machine/visionsom6ull.inc
```bitbake
# SoMLabs SLS16 (VisionSOM-6ULL) common board definition file

# Compatibility with mx6 machines
MACHINEOVERRIDES =. "mx6:mx6ull:"

include conf/machine/include/imx-base.inc
include conf/machine/include/tune-cortexa7.inc

# u-boot and kernel providers
PREFERRED_PROVIDER_u-boot = "u-boot-somlabs"
PREFERRED_PROVIDER_u-boot-fw-utils = "u-boot-somlabs-fw-utils"

PREFERRED_PROVIDER_virtual/bootloader = "u-boot-somlabs"
PREFERRED_PROVIDER_virtual/kernel = "linux-fslc"

# u-boot configurations
UBOOT_CONFIG[sd]   = "somlabs_visionsom_6ull_fastboot_mmc_defconfig"
UBOOT_CONFIG[emmc] = "somlabs_visionsom_6ull_fastboot_mmc_defconfig"
UBOOT_CONFIG[nand] = "somlabs_visionsom_6ull_fastboot_nand_defconfig"

# Always depend of u-boot
EXTRA_IMAGEDEPENDS += "u-boot-somlabs"

SERIAL_CONSOLE = "115200 ttymxc0"

# Add kernel in image
IMAGE_INSTALL_append = " kernel-image kernel-devicetree kernel-modules"

IMAGE_FSTYPES = "wic.gz"
```
