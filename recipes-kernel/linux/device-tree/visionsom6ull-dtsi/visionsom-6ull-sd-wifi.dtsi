/*
 * This program is free software; you can redistribute it and/or modify
 * it under the terms of the GNU General Public License version 2 as
 * published by the Free Software Foundation.
 */

#include "visionsom-6ull-sd.dtsi"
#include "visionsom-6ull-wifibt.dtsi"

/ {
        model = "SoMLabs VisionSOM-6ULL-sd-wifi";
};

