/*
 * Copyright 2019 
 *
 * This program is free software; you can redistribute it and/or modify
 * it under the terms of the GNU General Public License as published by
 * the Free Software Foundation; either version 2 of the License, or
 * (at your option) any later version.
 */

/dts-v1/;

#include "visionsom-6ull-nand-wifi.dtsi"
#include "visioncb-std.dtsi"

/ {
        model = "Somlabs VisionSOM6ULL nand WiFi on VisionCB-STD";
        compatible = "somlabs,visionsom6ull","somlabs,visioncb-std","fsl,imx6ull";
};
